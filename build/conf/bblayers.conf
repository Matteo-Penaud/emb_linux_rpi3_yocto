## build/conf/bblayers.conf
```bitbake
# POKY_BBLAYERS_CONF_VERSION is increased each time build/conf/bblayers.conf
# changes incompatibly
POKY_BBLAYERS_CONF_VERSION = "2"

BBPATH = "${TOPDIR}"
BBFILES ?= ""

BBLAYERS ?= " \
  /media/matt-mint/linux_data/LINUX/COURS/TEST_LAB2/poky/meta \
  /media/matt-mint/linux_data/LINUX/COURS/TEST_LAB2/poky/meta-poky \
  /media/matt-mint/linux_data/LINUX/COURS/TEST_LAB2/poky/meta-yocto-bsp \
  /media/matt-mint/linux_data/LINUX/COURS/TEST_LAB2/layers/meta-raspberrypi \
  /media/matt-mint/linux_data/LINUX/COURS/TEST_LAB2/layers/meta-openembedded/meta-oe \
  /media/matt-mint/linux_data/LINUX/COURS/TEST_LAB2/layers/meta-openembedded/meta-python \
  /media/matt-mint/linux_data/LINUX/COURS/TEST_LAB2/layers/meta-openembedded/meta-networking \
  /media/matt-mint/linux_data/LINUX/COURS/TEST_LAB2/layers/meta-openembedded/meta-filesystems \
  /media/matt-mint/linux_data/LINUX/COURS/TEST_LAB2/layers/meta-openembedded/meta-multimedia \
  /media/matt-mint/linux_data/LINUX/COURS/TEST_LAB2/layers/meta-virtualization \
  /media/matt-mint/linux_data/LINUX/COURS/TEST_LAB2/emb_linux_rpi3_yocto/meta-ynov-rpi3 \
  "
```
